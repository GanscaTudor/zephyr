## CMakeLists.txt
```
# SPDX-License-Identifier: Apache-2.0

cmake_minimum_required(VERSION 3.20.0)
find_package(Zephyr REQUIRED HINTS $ENV{ZEPHYR_BASE})
project(swiot1l)

target_sources(app PRIVATE src/main.c)
target_sources_ifdef(CONFIG_LIBIIO app PRIVATE
  src/iio_ad74413r.c
  src/iio_max14906.c
  src/iio_swiot.c
)
```

## sample.yaml
```
sample:
  name: AD-SWIOT1L-SL 10BASE-T1L
common:
  platform_allow:
    - ad_swiot1l_sl
  integration_platforms:
    - ad_swiot1l_sl
  tags:
    - net
    - ethernet
tests:
  sample.boards.adi.swiot1l: {}
  sample.boards.adi.swiot1l.iiod:
    extra_args:
      - EXTRA_CONF_FILE=overlay-iiod.conf
    modules:
      - libiio
    tags:
      - iio
```

## prj.conf
```kconfig
# IPv4 networking over the ADIN1110 10BASE-T1L interface
CONFIG_NETWORKING=y
CONFIG_NET_L2_ETHERNET=y
CONFIG_NET_IPV4=y
CONFIG_NET_IPV6=n
CONFIG_NET_ARP=y
CONFIG_NET_UDP=y
CONFIG_NET_TCP=y
CONFIG_NET_SOCKETS=y
CONFIG_NET_MGMT=y
CONFIG_NET_MGMT_EVENT=y

# Static address, same as the no-OS swiot1l_static_ip configuration
CONFIG_NET_CONFIG_SETTINGS=y
CONFIG_NET_CONFIG_NEED_IPV4=y
CONFIG_NET_CONFIG_MY_IPV4_ADDR="192.168.97.40"
CONFIG_NET_CONFIG_MY_IPV4_NETMASK="255.255.0.0"
CONFIG_NET_CONFIG_INIT_TIMEOUT=0

CONFIG_MDIO=y

# Console, logging and the network shell (net iface / net ping / net arp)
CONFIG_LOG=y
CONFIG_LOG_BUFFER_SIZE=4096
CONFIG_NET_LOG=y
CONFIG_SHELL=y
CONFIG_NET_SHELL=y

# MAX14906 digital outputs, driven from the gpio shell
CONFIG_GPIO_SHELL=y

CONFIG_MAIN_STACK_SIZE=2048
CONFIG_SYSTEM_WORKQUEUE_STACK_SIZE=2048

# The MAX32650 TRNG entropy driver does not build yet, use the timer based
# generator for sys_rand_get() (TCP ISN, ephemeral ports). Not secure.
CONFIG_TEST_RANDOM_GENERATOR=y
CONFIG_TIMER_RANDOM_GENERATOR=y
```

## overlay-iiod.conf
```kconfig
# IIOD server over the network (libiio Zephyr module), on TCP port 30431,
# the default for libiio "ip:" URIs
CONFIG_LIBIIO=y
CONFIG_LIBIIO_IIOD_NETWORK=y
CONFIG_POSIX_API=y
# libiio relies on GNU style static constructors
CONFIG_STATIC_INIT_GNU=y
```

## src/main.c
```c
/*
 * Copyright (c) 2026 Analog Devices, Inc.
 *
 * SPDX-License-Identifier: Apache-2.0
 */

#include <zephyr/kernel.h>
#include <zephyr/drivers/gpio.h>
#include <zephyr/logging/log.h>
#include <zephyr/net/net_if.h>
#include <zephyr/net/net_mgmt.h>

LOG_MODULE_REGISTER(swiot1l, LOG_LEVEL_INF);

static const struct gpio_dt_spec link_led = GPIO_DT_SPEC_GET(DT_ALIAS(led1), gpios);

static struct net_mgmt_event_callback iface_cb;

static void iface_event_handler(struct net_mgmt_event_callback *cb, uint64_t event,
				struct net_if *iface)
{
	ARG_UNUSED(cb);
	ARG_UNUSED(iface);

	if (event == NET_EVENT_IF_UP) {
		LOG_INF("T1L link up");
		gpio_pin_set_dt(&link_led, 1);
	} else if (event == NET_EVENT_IF_DOWN) {
		LOG_INF("T1L link down");
		gpio_pin_set_dt(&link_led, 0);
	}
}

int main(void)
{
	struct net_if *iface = net_if_get_default();

	if (gpio_is_ready_dt(&link_led)) {
		gpio_pin_configure_dt(&link_led, GPIO_OUTPUT_INACTIVE);
	}

	net_mgmt_init_event_callback(&iface_cb, iface_event_handler,
				     NET_EVENT_IF_UP | NET_EVENT_IF_DOWN);
	net_mgmt_add_event_callback(&iface_cb);

	if (iface == NULL) {
		LOG_ERR("No network interface");
		return 0;
	}

	LOG_INF("IPv4 %s/%s", CONFIG_NET_CONFIG_MY_IPV4_ADDR, CONFIG_NET_CONFIG_MY_IPV4_NETMASK);

	if (net_if_is_up(iface)) {
		gpio_pin_set_dt(&link_led, 1);
	}

	return 0;
}
```

## src/iio_ad74413r.c
```c
/*
 * Copyright (c) 2026 Analog Devices, Inc.
 *
 * SPDX-License-Identifier: Apache-2.0
 *
 * Placeholder "ad74413r" IIO device without channels. pyadi-iio's swiot1l
 * class opens the ad74413r device as soon as the swiot device is in
 * "runtime" mode and raises if it is missing, so it must exist for hosts
 * using that class to connect, even though the AD74413R is not supported
 * yet.
 */

#include <zephyr/device.h>
#include <iio/iio-backend.h>
#include <iio_device.h>

static int iio_ad74413r_add_channels(const struct device *dev, struct iio_device *iio_device)
{
	ARG_UNUSED(dev);
	ARG_UNUSED(iio_device);

	return 0;
}

static DEVICE_API(iio_device, iio_ad74413r_api) = {
	.add_channels = iio_ad74413r_add_channels,
};

DEVICE_DEFINE(iio_ad74413r, "iio_ad74413r", NULL, NULL, NULL, NULL, POST_KERNEL,
	      CONFIG_KERNEL_INIT_PRIORITY_DEVICE, &iio_ad74413r_api);

IIO_DEVICE_INFO_DEFINE(iio_ad74413r_info, DEVICE_GET(iio_ad74413r), "ad74413r");
```

## src/iio_max14906.c
```c
/*
 * Copyright (c) 2026 Analog Devices, Inc.
 *
 * SPDX-License-Identifier: Apache-2.0
 *
 * "max14906" IIO device: one output channel per MAX14906 channel
 * (voltage0..voltage3), backed by the max14906 GPIO controller. The "raw"
 * attribute sets or reads the channel level, as with the no-OS firmware.
 */

#include <errno.h>
#include <stdlib.h>
#include <string.h>

#include <zephyr/device.h>
#include <zephyr/drivers/gpio.h>
#include <zephyr/logging/log.h>
#include <iio/iio-backend.h>
#include <iio_device.h>

LOG_MODULE_REGISTER(iio_max14906, LOG_LEVEL_INF);

#define MAX14906_CHANNELS 4

static const struct device *const max14906 = DEVICE_DT_GET(DT_NODELABEL(max14906));

static int iio_max14906_add_channels(const struct device *dev, struct iio_device *iio_device)
{
	static const char *const attrs[] = { "raw", "scale", "offset" };
	const struct iio_data_format fmt = {
		.length = 8,
		.bits = 1,
	};
	char id[16];

	ARG_UNUSED(dev);

	for (uint32_t ch = 0; ch < MAX14906_CHANNELS; ch++) {
		struct iio_channel *chn;

		snprintk(id, sizeof(id), "voltage%u", ch);

		chn = iio_device_add_channel(iio_device, ch, id, NULL, NULL, true, false, &fmt);
		if (iio_err(chn)) {
			LOG_ERR("Could not add channel %s", id);
			return -EINVAL;
		}

		iio_channel_set_pdata(chn, (struct iio_channel_pdata *)(uintptr_t)ch);

		for (size_t i = 0; i < ARRAY_SIZE(attrs); i++) {
			if (iio_channel_add_attr(chn, attrs[i], IIO_ATTR_TYPE_CHANNEL, NULL)) {
				LOG_ERR("Could not add %s to %s", attrs[i], id);
				return -EINVAL;
			}
		}
	}

	return 0;
}

static gpio_pin_t attr_channel(const struct iio_attr *attr)
{
	return (gpio_pin_t)(uintptr_t)iio_channel_get_pdata(attr->iio.chn);
}

static int iio_max14906_read_attr(const struct device *dev, const struct iio_device *iio_device,
				  const struct iio_attr *attr, char *dst, size_t len)
{
	int val;

	ARG_UNUSED(dev);
	ARG_UNUSED(iio_device);

	if (attr->type != IIO_ATTR_TYPE_CHANNEL) {
		return -EINVAL;
	}

	if (strcmp(attr->name, "raw") == 0) {
		if (!device_is_ready(max14906)) {
			return -ENODEV;
		}
		val = gpio_pin_get(max14906, attr_channel(attr));
		if (val < 0) {
			return val;
		}
		return snprintk(dst, len, "%d", val) + 1;
	} else if (strcmp(attr->name, "scale") == 0) {
		return snprintk(dst, len, "1") + 1;
	} else if (strcmp(attr->name, "offset") == 0) {
		return snprintk(dst, len, "0") + 1;
	}

	return -EINVAL;
}

static int iio_max14906_write_attr(const struct device *dev, const struct iio_device *iio_device,
				   const struct iio_attr *attr, const char *src, size_t len)
{
	int ret;

	ARG_UNUSED(dev);
	ARG_UNUSED(iio_device);

	if (attr->type != IIO_ATTR_TYPE_CHANNEL || strcmp(attr->name, "raw") != 0) {
		return -EINVAL;
	}

	if (!device_is_ready(max14906)) {
		return -ENODEV;
	}

	ret = gpio_pin_set(max14906, attr_channel(attr), strtoul(src, NULL, 10) ? 1 : 0);
	if (ret < 0) {
		return ret;
	}

	return (int)len;
}

static DEVICE_API(iio_device, iio_max14906_api) = {
	.add_channels = iio_max14906_add_channels,
	.read_attr = iio_max14906_read_attr,
	.write_attr = iio_max14906_write_attr,
};

DEVICE_DEFINE(iio_max14906, "iio_max14906", NULL, NULL, NULL, NULL, POST_KERNEL,
	      CONFIG_KERNEL_INIT_PRIORITY_DEVICE, &iio_max14906_api);

IIO_DEVICE_INFO_DEFINE(iio_max14906_info, DEVICE_GET(iio_max14906), "max14906");
```

## src/iio_swiot.c
```c
/*
 * Copyright (c) 2026 Analog Devices, Inc.
 *
 * SPDX-License-Identifier: Apache-2.0
 *
 * "swiot" IIO device: the channel configuration device of the no-OS
 * firmware for this board. It has no channels, only the device attributes
 * pyadi-iio's swiot1l class uses (mode, chN_device, chN_function,
 * chN_enable and their _available lists).
 *
 * A channel assigned to the max14906 with the "output" or "input" function
 * is configured on the MAX14906 as soon as it is enabled. Channels assigned
 * to the ad74413r, and the "high_z" function, are only stored: the AD74413R
 * is not supported yet and the MAX14906 GPIO driver has no high-Z mode.
 */

#include <errno.h>
#include <string.h>

#include <zephyr/device.h>
#include <zephyr/drivers/gpio.h>
#include <zephyr/logging/log.h>
#include <iio/iio-backend.h>
#include <iio_device.h>

LOG_MODULE_REGISTER(iio_swiot, LOG_LEVEL_INF);

#define SWIOT_CHANNELS 4
#define SWIOT_STR_LEN  16

struct swiot_channel {
	char device[SWIOT_STR_LEN];
	char function[SWIOT_STR_LEN];
	char enable[2];
};

static struct {
	char mode[SWIOT_STR_LEN];
	char identify[2];
	struct swiot_channel ch[SWIOT_CHANNELS];
} swiot = {
	.mode = "config",
	.identify = "0",
};

static const struct device *const max14906 = DEVICE_DT_GET(DT_NODELABEL(max14906));

static const char *const channel_attrs[] = {
	"function", "device", "enable", "function_available", "device_available",
};

static void swiot_apply_channel(uint32_t ch)
{
	const struct swiot_channel *c = &swiot.ch[ch];
	gpio_flags_t flags;
	int ret;

	if (strcmp(c->device, "max14906") != 0 || strcmp(c->enable, "1") != 0) {
		return;
	}

	if (!device_is_ready(max14906)) {
		LOG_ERR("max14906 not ready, channel %u not configured", ch);
		return;
	}

	if (strcmp(c->function, "output") == 0) {
		flags = GPIO_OUTPUT_INACTIVE;
	} else if (strcmp(c->function, "input") == 0) {
		flags = GPIO_INPUT;
	} else {
		return;
	}

	ret = gpio_pin_configure(max14906, ch, flags);
	if (ret < 0) {
		LOG_ERR("Failed to configure max14906 channel %u: %d", ch, ret);
	}
}

static int swiot_add_channels(const struct device *dev, struct iio_device *iio_device)
{
	static const char *const dev_attrs[] = {
		"mode", "mode_available", "identify", "serial_id", "ext_psu",
	};
	char name[32];

	ARG_UNUSED(dev);

	for (size_t i = 0; i < ARRAY_SIZE(dev_attrs); i++) {
		if (iio_device_add_attr(iio_device, dev_attrs[i], IIO_ATTR_TYPE_DEVICE)) {
			return -EINVAL;
		}
	}

	for (uint32_t ch = 0; ch < SWIOT_CHANNELS; ch++) {
		for (size_t i = 0; i < ARRAY_SIZE(channel_attrs); i++) {
			snprintk(name, sizeof(name), "ch%u_%s", ch, channel_attrs[i]);
			if (iio_device_add_attr(iio_device, name, IIO_ATTR_TYPE_DEVICE)) {
				return -EINVAL;
			}
		}
	}

	return 0;
}

/* "chN_<suffix>": return N and point suffix past the underscore, or -1. */
static int parse_channel_attr(const char *name, const char **suffix)
{
	if (strncmp(name, "ch", 2) != 0 || name[2] < '0' || name[2] >= '0' + SWIOT_CHANNELS ||
	    name[3] != '_') {
		return -1;
	}

	*suffix = &name[4];
	return name[2] - '0';
}

static int swiot_read_attr(const struct device *dev, const struct iio_device *iio_device,
			   const struct iio_attr *attr, char *dst, size_t len)
{
	const char *val = NULL;
	const char *suffix;
	int ch;

	ARG_UNUSED(dev);
	ARG_UNUSED(iio_device);

	if (strcmp(attr->name, "mode") == 0) {
		val = swiot.mode;
	} else if (strcmp(attr->name, "mode_available") == 0) {
		val = "config runtime";
	} else if (strcmp(attr->name, "identify") == 0) {
		val = swiot.identify;
	} else if (strcmp(attr->name, "serial_id") == 0) {
		val = "ad-swiot1l-sl";
	} else if (strcmp(attr->name, "ext_psu") == 0) {
		val = "0";
	} else {
		ch = parse_channel_attr(attr->name, &suffix);
		if (ch < 0) {
			return -EINVAL;
		}

		if (strcmp(suffix, "function") == 0) {
			val = swiot.ch[ch].function;
		} else if (strcmp(suffix, "device") == 0) {
			val = swiot.ch[ch].device;
		} else if (strcmp(suffix, "enable") == 0) {
			val = swiot.ch[ch].enable;
		} else if (strcmp(suffix, "function_available") == 0) {
			val = "high_z output input";
		} else if (strcmp(suffix, "device_available") == 0) {
			val = "ad74413r max14906";
		}
	}

	if (val == NULL) {
		return -EINVAL;
	}

	return snprintk(dst, len, "%s", val) + 1;
}

static int swiot_write_attr(const struct device *dev, const struct iio_device *iio_device,
			    const struct iio_attr *attr, const char *src, size_t len)
{
	const char *suffix;
	char *dst;
	size_t size;
	int ch = -1;

	ARG_UNUSED(dev);
	ARG_UNUSED(iio_device);

	if (strcmp(attr->name, "mode") == 0) {
		dst = swiot.mode;
		size = sizeof(swiot.mode);
	} else if (strcmp(attr->name, "identify") == 0) {
		dst = swiot.identify;
		size = sizeof(swiot.identify);
	} else {
		ch = parse_channel_attr(attr->name, &suffix);
		if (ch < 0) {
			return -EINVAL;
		}

		if (strcmp(suffix, "function") == 0) {
			dst = swiot.ch[ch].function;
			size = sizeof(swiot.ch[ch].function);
		} else if (strcmp(suffix, "device") == 0) {
			dst = swiot.ch[ch].device;
			size = sizeof(swiot.ch[ch].device);
		} else if (strcmp(suffix, "enable") == 0) {
			dst = swiot.ch[ch].enable;
			size = sizeof(swiot.ch[ch].enable);
		} else {
			return -EINVAL;
		}
	}

	strncpy(dst, src, size - 1);
	dst[size - 1] = '\0';

	if (ch >= 0) {
		swiot_apply_channel(ch);
	}

	return (int)len;
}

static DEVICE_API(iio_device, swiot_api) = {
	.add_channels = swiot_add_channels,
	.read_attr = swiot_read_attr,
	.write_attr = swiot_write_attr,
};

DEVICE_DEFINE(iio_swiot, "iio_swiot", NULL, NULL, NULL, NULL, POST_KERNEL,
	      CONFIG_KERNEL_INIT_PRIORITY_DEVICE, &swiot_api);

IIO_DEVICE_INFO_DEFINE(iio_swiot_info, DEVICE_GET(iio_swiot), "swiot");
```
